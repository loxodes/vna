// Compile with dtb-rebuilder
   
/dts-v1/;  
/plugin/;  

#include <dt-bindings/board/am335x-bbw-bbb-base.h>
#include <dt-bindings/gpio/gpio.h>
#include <dt-bindings/pinctrl/am33xx.h>

/ {  
   // AD_DOUTD - pru1 r31 bit 0
   // AD_DOUTC - pru1 r31 bit 1
   // AD_DOUTB - pru1 r31 bit 2
   // AD_DOUTA - pru1 r31 bit 3
    
   // AD_FS     - pru1 r31 bit 4
   // AD_CLKOUT - pru1 r31 bit 5

   // RF_SEL_PRU - pru1 r30 bit 7
   // exclusive-use = "P8_45", "P8_46", "P8_43", "P8_44", P8_41", "P8_42", "P8_40", "pru1";  
   
   fragment@0 {  
    target = <&am33xx_pinmux>;  
    __overlay__ {
        example_pins: pinmux_pru_pru_pins {
   
        pinctrl-single,pins = <
            AM33XX_IOPAD(0x08a0, PIN_INPUT | MUX_MODE6) /* AD_DOUTD */
            AM33XX_IOPAD(0x08a4, PIN_INPUT | MUX_MODE6) /* AD_DOUTC */
            AM33XX_IOPAD(0x08a8, PIN_INPUT | MUX_MODE6) /* AD_DOUTB */
            AM33XX_IOPAD(0x08ac, PIN_INPUT | MUX_MODE6) /* AD_DOUTA */
            AM33XX_IOPAD(0x08b0, PIN_INPUT | MUX_MODE6) /* AD_FS */
            AM33XX_IOPAD(0x08b4, PIN_INPUT | MUX_MODE6) /* AD_CLKOUT */
            AM33XX_IOPAD(0x08bc, PIN_OUTPUT | MUX_MODE5) /* RF_SEL_PRU */

       >;  
      };  
    };  
   };  
   
   // This enables the PRU and assigns the GPIO pins to it for use in EGP mode.  
   fragment@1 {  
    target = <&pruss>;  
    __overlay__ {  
      status = "okay";  
      pinctrl-names = "default";  
      pinctrl-0 = <&example_pins>;  
    };  
   };  
 };  
  
